AUTOSAR XML (schema 00049)
package /AUTOSAR/ExecutionManagement/ModeDeclarationGroups
  mode declaration group ProcessStates: initial-mode=Idle  # Mode declaration group for process states.
    5 x mode:
      Idle  # The Idle Process State shall be the Process State prior to creation of the Process and to resource allocation.
      Starting  # The Starting Process State shall apply when the Process has been created and resources have been allocated.
      Running  # The Running Process State shall apply to a Reporting Process after it has reported kRunning Execution State to Execution Management.
      Terminating  # The Terminating Process State shall apply when Execution Management sent SIGTERM signal to the Process.
      Terminated  # The Terminated Process State shall apply after the Process has terminated and the Process resources have been freed.
package /AUTOSAR/ExecutionManagement/LifeCycleInfoSets
  life cycle info set ProcessStates: default-lc-state=draft
    life-cycle-infos:
      lc-object=Idle, lc-state=draft
      lc-object=Starting, lc-state=draft
      lc-object=Running, lc-state=draft
      lc-object=Terminating, lc-state=draft
      lc-object=Terminated, lc-state=draft
